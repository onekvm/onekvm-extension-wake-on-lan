## meta-onekvm-extension-wake-on-lan/conf/layer.conf
```bitbake
BBPATH .= ":${LAYERDIR}"

BBFILES += "${LAYERDIR}/recipes-*/*/*.bb \
            ${LAYERDIR}/recipes-*/*/*.bbappend"

BBFILE_COLLECTIONS += "onekvm-extension-wake-on-lan"
BBFILE_PATTERN_onekvm-extension-wake-on-lan := "^${LAYERDIR}/"
BBFILE_PRIORITY_onekvm-extension-wake-on-lan = "8"

LAYERDEPENDS_onekvm-extension-wake-on-lan = "core onekvm"
LAYERSERIES_COMPAT_onekvm-extension-wake-on-lan = "wrynose"
```
